## CMakeLists.txt
```
# EOP edge firmware (US-401..US-403, ADR-014). Built with west against the workspace that
# scripts/zephyr-setup.sh creates from west.yml.
cmake_minimum_required(VERSION 3.20.0)

find_package(Zephyr REQUIRED HINTS $ENV{ZEPHYR_BASE})
project(eop_edge LANGUAGES C)

target_include_directories(app PRIVATE include)
target_sources(app PRIVATE
  src/main.c
  src/sensor.c
  src/mqtt_pub.c
  src/telemetry.c
  src/backoff.c
  src/queue.c
  src/flush.c
  src/link.c
  src/status.c
  src/shell.c
  src/watchdog.c
  src/supervisor.c
  src/led.c
  src/led_pattern.c
  src/fatal.c
  src/platform.c
)

# The board decides where the wall clock and the configuration overrides come from.
if(CONFIG_EOP_CLOCK_SNTP)
  target_sources(app PRIVATE src/platform_sntp.c)
  target_sources_ifdef(CONFIG_WIFI app PRIVATE src/wifi_link.c)
else()
  target_sources(app PRIVATE src/platform_native_sim.c)
endif()

# TLS to the broker (tls.conf): the broker's CA is built into the firmware from a file given at
# build time, never committed (scripts/edge-certs.sh creates it).
if(CONFIG_EOP_MQTT_TLS)
  set(EOP_MQTT_CA_CERT "" CACHE FILEPATH "CA certificate (PEM) that signed the broker's certificate")
  if(NOT EXISTS "${EOP_MQTT_CA_CERT}")
    message(FATAL_ERROR "tls.conf needs -DEOP_MQTT_CA_CERT=<path to the broker's ca.crt>")
  endif()
  generate_inc_file_for_target(app ${EOP_MQTT_CA_CERT} ${ZEPHYR_BINARY_DIR}/include/generated/eop_ca_cert.inc)
  target_sources(app PRIVATE src/tls.c)
endif()
```

## Kconfig
```
# EOP edge firmware configuration (ADR-014). Every value the firmware needs comes from here and
# is set in prj.conf or a board .conf file: nothing is hardcoded in the sources (US-401 AC7).

mainmenu "EOP edge firmware"

menu "EOP edge device"

config EOP_NODE_ID
	string "Node id"
	default "vault-101"
	help
	  Identity of the bunker in EOP: [a-z0-9-]{1,63}, not starting with hpc-engine. It is the
	  MQTT client id and a segment of every topic. On native_sim, --node-id overrides it.

config EOP_BUNKER_NAME
	string "Bunker name"
	default "Vault-101"
	help
	  Readable name shown in /v1/nodes: [A-Za-z0-9_.-]{1,63}. On native_sim, --bunker-name
	  overrides it.

config EOP_SAMPLE_PERIOD_MS
	int "Sampling period (ms)"
	default 1000
	range 100 60000

config EOP_QUEUE_LEN
	int "Telemetry queue length (samples)"
	default 60
	range 1 600
	help
	  Samples held between the sensor and the MQTT thread. It is also the offline buffer:
	  60 samples at one per second are 60 seconds without the broker (US-402 AC1).

config EOP_TEMP_INITIAL_DC
	int "Initial simulated temperature (tenths of a degree C)"
	default 210

config EOP_TEMP_MIN_DC
	int "Lowest simulated temperature (tenths of a degree C)"
	default 150

config EOP_TEMP_MAX_DC
	int "Highest simulated temperature (tenths of a degree C)"
	default 400

config EOP_TEMP_STEP_DC
	int "Largest change between two samples (tenths of a degree C)"
	default 4

config EOP_TEMP_WARN_DC
	int "Temperature from which the status is WARN (tenths of a degree C)"
	default 300

config EOP_TEMP_ALERT_DC
	int "Temperature from which the status is ALERT (tenths of a degree C)"
	default 350

endmenu

menu "EOP MQTT"

config EOP_MQTT_BROKER_HOST
	string "Broker host name or address"
	default "mosquitto"
	help
	  On native_sim, --broker-host overrides it.

config EOP_MQTT_BROKER_PORT
	int "Broker port"
	default 1883
	range 1 65535
	help
	  On native_sim, --broker-port overrides it.

config EOP_MQTT_TOPIC_PREFIX
	string "Topic prefix"
	default "eop/bunker"
	help
	  Topics are <prefix>/<node_id>/telemetry, /events and /health.

config EOP_MQTT_TLS
	bool "TLS to the broker"
	depends on MQTT_LIB_TLS && NET_SOCKETS_SOCKOPT_TLS && TLS_CREDENTIALS
	help
	  The broker's device listener (8883, ADR-013) over TLS 1.2. The device verifies the broker's
	  certificate against the CA given at build time with -DEOP_MQTT_CA_CERT=<ca.crt> (the CA of
	  scripts/edge-certs.sh); there is no client certificate. tls.conf turns it on.

config EOP_MQTT_TLS_HOSTNAME
	string "Name checked against the broker's certificate"
	default ""
	depends on EOP_MQTT_TLS
	help
	  Empty: the broker host itself. Set it when the device reaches the broker by an address the
	  certificate does not name.

config EOP_MQTT_KEEPALIVE_S
	int "MQTT keep-alive (s)"
	default 30

config EOP_MQTT_CONNECT_TIMEOUT_MS
	int "Time to wait for CONNACK (ms)"
	default 5000

config EOP_MQTT_ACK_TIMEOUT_MS
	int "Time to wait for a PUBACK before reconnecting (ms)"
	default 5000

config EOP_MQTT_POLL_MS
	int "Socket poll interval of the MQTT thread (ms)"
	default 100
	help
	  How long the MQTT thread waits for broker input before checking the queue again. Bounds
	  the extra latency a sample can wait in the queue.

config EOP_MQTT_BUFFER_SIZE
	int "MQTT rx/tx buffer size (bytes)"
	default 512

config EOP_PAYLOAD_MAX_LEN
	int "Largest JSON payload (bytes)"
	default 320
	help
	  Telemetry of a device whose node id and bunker name are both 63 characters long takes
	  277 bytes; tests/unit checks that every payload fits in the default.

config EOP_HEALTH_PERIOD_MS
	int "Health report period (ms)"
	default 10000
	range 1000 600000
	help
	  How often the device publishes to <prefix>/<node_id>/health while connected: uptime,
	  thread restarts, buffered and dropped samples (protocol §2.3, US-402 AC8).

config EOP_BACKOFF_INITIAL_S
	int "First reconnection delay (s)"
	default 1

config EOP_BACKOFF_MAX_S
	int "Largest reconnection delay (s)"
	default 30
	help
	  Delays double from EOP_BACKOFF_INITIAL_S up to this value: 1, 2, 4, 8, 16, 30 s
	  (US-401 AC5).

endmenu

menu "EOP threads"

config EOP_SENSOR_PRIORITY
	int "Sensor thread priority"
	default 5

config EOP_MQTT_PRIORITY
	int "MQTT thread priority"
	default 6

config EOP_SENSOR_STACK_SIZE
	int "Sensor thread stack (bytes)"
	default 512

config EOP_MQTT_STACK_SIZE
	int "MQTT thread stack (bytes)"
	default 2048

config EOP_SUPERVISOR_PRIORITY
	int "Supervisor (watchdog) thread priority"
	default 1
	help
	  Higher than the threads it watches, so a busy thread cannot starve it (ADR-014).

config EOP_SUPERVISOR_STACK_SIZE
	int "Supervisor thread stack (bytes)"
	default 1024

endmenu

menu "EOP resilience (US-403)"

config EOP_WDT_TIMEOUT_MS
	int "Longest time a thread may go without checking in (ms)"
	default 5000
	help
	  A sensor or MQTT thread silent for longer is restarted by the supervisor (US-403 AC1).
	  Every blocking wait in those threads is shorter than this, or split in shorter steps.

config EOP_WDT_CHECK_MS
	int "Supervisor check period (ms)"
	default 1000
	help
	  Period of the supervisor's k_timer: a hung thread is restarted between EOP_WDT_TIMEOUT_MS
	  and EOP_WDT_TIMEOUT_MS + EOP_WDT_CHECK_MS after its last check-in.

config EOP_LED_ERROR_HOLD_MS
	int "How long the LED shows the thread-error pattern after a restart (ms)"
	default 10000

config EOP_FAULT_INJECT
	bool "Fault injection shell commands (test builds only)"
	help
	  Adds `eop fault hang sensor|mqtt` (the thread stops checking in, so the watchdog restarts
	  it) and `eop fault crash` (a fatal kernel error, so the device reboots), for the US-403
	  tests (AC6). Enabled by fault_inject.conf; never in a device build.

endmenu

menu "EOP clock"

config EOP_CLOCK_SNTP
	def_bool !BOARD_NATIVE_SIM
	select SNTP
	help
	  Telemetry timestamps come from the wall clock. On real hardware it is set with SNTP at
	  boot (src/platform_sntp.c); on native_sim it is taken from the host
	  (src/platform_native_sim.c).

config EOP_SNTP_SERVER
	string "SNTP server"
	default "pool.ntp.org"
	depends on EOP_CLOCK_SNTP

config EOP_SNTP_TIMEOUT_MS
	int "SNTP query timeout (ms)"
	default 3000
	depends on EOP_CLOCK_SNTP

endmenu

menu "EOP WiFi (hardware build)"
	depends on WIFI

config EOP_WIFI_SSID
	string "WiFi network"
	default ""
	help
	  Set it in an untracked overlay (see README, "ESP32 build"), never in prj.conf: it is
	  site configuration, and the password next to it is a credential.

config EOP_WIFI_PSK
	string "WiFi password (empty for an open network)"
	default ""

config EOP_WIFI_TIMEOUT_MS
	int "Time to join the network and get an address (ms)"
	default 30000

endmenu

source "Kconfig.zephyr"
```

## west.yml
```
# Zephyr workspace of the EOP edge firmware (ADR-014). scripts/zephyr-setup.sh builds the
# workspace outside the repository from this file, and make, CI and the Dockerfile all use it,
# so the Zephyr version is pinned in one place.
manifest:
  version: "1.2"

  remotes:
    - name: zephyrproject-rtos
      url-base: https://github.com/zephyrproject-rtos

  # The ESP32 HAL is only needed for the board build (zephyr-setup.sh --esp32 enables it). Mbed TLS
  # and TF-PSA-Crypto are always fetched: the TLS build (tls.conf) is tested on native_sim too, and
  # the board's WiFi driver uses them.
  group-filter: [-hal]

  projects:
    - name: zephyr
      remote: zephyrproject-rtos
      revision: v4.4.2
      clone-depth: 1
      import:
        name-allowlist:
          - hal_espressif
          - mbedtls
          - tf-psa-crypto

  self:
    path: eop-edge-manifest
```

## prj.conf
```kconfig
# EOP edge firmware, settings shared by every board. Device identity, broker and topic prefix
# are here too (US-401 AC7); see Kconfig for what each option means.
CONFIG_EOP_NODE_ID="vault-101"
CONFIG_EOP_BUNKER_NAME="Vault-101"
CONFIG_EOP_MQTT_BROKER_HOST="mosquitto"
CONFIG_EOP_MQTT_BROKER_PORT=1883
CONFIG_EOP_MQTT_TOPIC_PREFIX="eop/bunker"

# Kernel
CONFIG_MAIN_STACK_SIZE=2048
CONFIG_HEAP_MEM_POOL_SIZE=4096
CONFIG_ENTROPY_GENERATOR=y

# Networking and MQTT
CONFIG_NETWORKING=y
CONFIG_NET_SOCKETS=y
CONFIG_NET_TCP=y
CONFIG_NET_IPV4=y
CONFIG_NET_IPV6=n
CONFIG_MQTT_LIB=y

# A fatal kernel error reboots the device (US-403 AC4); the status LED is a GPIO (AC5)
CONFIG_REBOOT=y
CONFIG_GPIO=y

# Logs and the `eop status` shell command (US-401 AC8)
CONFIG_LOG=y
CONFIG_SHELL=y
```

## fault_inject.conf
```kconfig
# Test build of the firmware (US-403 AC6): adds the `eop fault` shell commands. Used by
# make firmware-integration-test; never flashed to a device.
CONFIG_EOP_FAULT_INJECT=y
```

## tls.conf
```kconfig
# TLS to the broker's device listener (ADR-013): add with -DEXTRA_CONF_FILE=tls.conf and give the
# broker's CA with -DEOP_MQTT_CA_CERT=<path to ca.crt> (make edge-certs creates it). README, "TLS".
CONFIG_EOP_MQTT_TLS=y
CONFIG_EOP_MQTT_BROKER_PORT=8883

CONFIG_MQTT_LIB_TLS=y
CONFIG_NET_SOCKETS_SOCKOPT_TLS=y
CONFIG_TLS_CREDENTIALS=y

# Mbed TLS: TLS 1.2 with the suite the broker offers first (ECDHE-RSA-AES128-GCM-SHA256), the
# broker's certificate checked against the CA in PEM.
CONFIG_MBEDTLS=y
CONFIG_MBEDTLS_PEM_PARSE_C=y
CONFIG_MBEDTLS_CIPHERSUITE_TLS_ECDHE_RSA_WITH_AES_128_GCM_SHA256=y
CONFIG_MBEDTLS_ENABLE_HEAP=y
CONFIG_MBEDTLS_HEAP_SIZE=40000
CONFIG_MBEDTLS_SSL_MAX_CONTENT_LEN=2048

# The handshake runs on the MQTT thread.
CONFIG_EOP_MQTT_STACK_SIZE=8192
```

## boards/esp32_devkitc_procpu.conf
```kconfig
# ESP32-DevKitC (ADR-014): the board the firmware targets once one is available. WiFi station
# with DHCP, DNS for the broker name, SNTP for the wall clock (src/platform_sntp.c). The network
# name and password come from an untracked overlay: see README "ESP32 build".
CONFIG_WIFI=y
CONFIG_NET_L2_WIFI_MGMT=y
CONFIG_NET_MGMT=y
CONFIG_NET_MGMT_EVENT=y
CONFIG_NET_MGMT_EVENT_INFO=y
CONFIG_NET_DHCPV4=y
CONFIG_DNS_RESOLVER=y
CONFIG_NET_UDP=y

# The PRD's thread stacks (ADR-014) are the Kconfig defaults; the WiFi stack needs more heap.
CONFIG_HEAP_MEM_POOL_SIZE=16384

# Rejoin the network after losing it; the MQTT thread buffers meanwhile (US-402).
CONFIG_ESP32_WIFI_STA_RECONNECT=y
```

## boards/native_sim_native_64.conf
```kconfig
# native_sim (ADR-014 "Running without an ESP32"): the host's sockets through Native Simulator
# offloaded sockets, so no TAP interface or root is needed, and the shell on stdin/stdout.
CONFIG_ETH_NATIVE_TAP=n
CONFIG_NET_DRIVERS=y
CONFIG_NET_SOCKETS_OFFLOAD=y
CONFIG_NET_NATIVE_OFFLOADED_SOCKETS=y
CONFIG_UART_NATIVE_PTY_0_ON_STDINOUT=y

# Host stack frames are larger than the ESP32's: the PRD's 512 / 2048 bytes are not enough here.
CONFIG_EOP_SENSOR_STACK_SIZE=4096
CONFIG_EOP_MQTT_STACK_SIZE=8192
CONFIG_EOP_SUPERVISOR_STACK_SIZE=4096

# sys_reboot() restarts the process, so a fatal error reboots the simulated device (US-403 AC4).
CONFIG_NATIVE_SIM_REBOOT=y

# Logs go to stdout through the UART backend only: the shell's own log backend would print every
# line a second time. No colours, so container logs read cleanly in Loki.
CONFIG_SHELL_LOG_BACKEND=n
CONFIG_LOG_BACKEND_SHOW_COLOR=n
CONFIG_SHELL_VT100_COLORS=n
```

## boards/esp32_devkitc_procpu.overlay
```dts
/*
 * Status LED of the EOP edge device (US-403 AC5, README "LED patterns"). The ESP32-DevKitC has
 * no user LED: this one is wired to GPIO2 (the on-board LED of most other ESP32 boards). Change
 * the pin here for another board or wiring.
 */

/ {
	aliases {
		led0 = &eop_status_led;
	};

	eop_leds {
		compatible = "gpio-leds";

		eop_status_led: eop_status_led {
			gpios = <&gpio0 2 GPIO_ACTIVE_HIGH>;
			label = "EOP status LED";
		};
	};
};
```

## src/main.c
```c
/*
 * EOP edge firmware (US-401, ADR-014): reads the configuration, sets the wall clock and starts
 * the sensor and MQTT threads. Everything the threads share lives here and is handed to them
 * through their first argument.
 */

#include <zephyr/kernel.h>
#include <zephyr/logging/log.h>

#include "eop_link.h"
#include "eop_platform.h"
#include "eop_queue.h"
#include "eop_status.h"
#include "eop_threads.h"

LOG_MODULE_REGISTER(eop_main, LOG_LEVEL_INF);

#define QUEUE_ALIGN 4

static struct eop_device_config device_config;
static struct eop_queue telemetry_queue;
static struct eop_status_board status_board;
static struct eop_link network_link;
static struct eop_context context;
static char
	__aligned(QUEUE_ALIGN) queue_buffer[CONFIG_EOP_QUEUE_LEN * sizeof(struct eop_telemetry)];

K_THREAD_STACK_DEFINE(sensor_stack, CONFIG_EOP_SENSOR_STACK_SIZE);
K_THREAD_STACK_DEFINE(mqtt_stack, CONFIG_EOP_MQTT_STACK_SIZE);
static struct k_thread sensor_thread;
static struct k_thread mqtt_thread;

int main(void)
{
	int ret = eop_platform_config(&device_config);

	if (ret < 0) {
		LOG_ERR("invalid configuration; not starting");
		return ret;
	}
	ret = eop_platform_set_clock();
	if (ret < 0) {
		LOG_ERR("wall clock not set (%d); timestamps would be wrong, not starting", ret);
		return ret;
	}

	eop_queue_init(&telemetry_queue, queue_buffer, CONFIG_EOP_QUEUE_LEN);
	eop_status_init(&status_board, &telemetry_queue);
	eop_link_init(&network_link, true);
	eop_shell_attach(&status_board, &network_link);
	context = (struct eop_context){
		.config = &device_config,
		.queue = &telemetry_queue,
		.status = &status_board,
		.link = &network_link,
	};

	LOG_INF("node %s (%s), boot %s, broker %s:%u", device_config.node_id,
		device_config.bunker_name, device_config.boot_id, device_config.broker_host,
		device_config.broker_port);

	k_thread_create(&sensor_thread, sensor_stack, K_THREAD_STACK_SIZEOF(sensor_stack),
			eop_sensor_thread, &context, NULL, NULL, CONFIG_EOP_SENSOR_PRIORITY, 0,
			K_NO_WAIT);
	k_thread_name_set(&sensor_thread, "eop_sensor");
	k_thread_create(&mqtt_thread, mqtt_stack, K_THREAD_STACK_SIZEOF(mqtt_stack),
			eop_mqtt_thread, &context, NULL, NULL, CONFIG_EOP_MQTT_PRIORITY, 0,
			K_NO_WAIT);
	k_thread_name_set(&mqtt_thread, "eop_mqtt");
	return 0;
}
```

## include/eop_backoff.h
```c
/**
 * @file eop_backoff.h
 * @brief Exponential backoff between broker reconnection attempts (US-401 AC5, US-402 AC5).
 * @details Delays double from an initial value up to a cap: with 1 s and 30 s the sequence is
 *          1, 2, 4, 8, 16, 30, 30 … seconds. Pure arithmetic, no kernel calls, so it is unit
 *          tested on its own.
 */

#ifndef EOP_BACKOFF_H
#define EOP_BACKOFF_H

#include <stdint.h>

/**
 * @brief Backoff state of one connection.
 * @invariant initial_s <= next_s <= max_s.
 */
struct eop_backoff {
	uint32_t initial_s; /**< First delay. */
	uint32_t max_s;     /**< Largest delay. */
	uint32_t next_s;    /**< Delay returned by the next call to eop_backoff_next(). */
};

/**
 * @brief Prepares a backoff that starts at @p initial_s and never exceeds @p max_s.
 * @param backoff State to initialise.
 * @param initial_s First delay in seconds; 0 is treated as 1.
 * @param max_s Largest delay in seconds; raised to @p initial_s if smaller.
 * @post eop_backoff_next() returns the initial delay.
 */
void eop_backoff_init(struct eop_backoff *backoff, uint32_t initial_s, uint32_t max_s);

/**
 * @brief Returns the delay to wait before the next attempt and doubles the following one.
 * @param backoff State of the connection.
 * @return Delay in seconds, between the initial delay and the cap.
 */
uint32_t eop_backoff_next(struct eop_backoff *backoff);

/**
 * @brief Starts the sequence again, after a successful connection.
 * @param backoff State of the connection.
 * @post eop_backoff_next() returns the initial delay.
 */
void eop_backoff_reset(struct eop_backoff *backoff);

#endif /* EOP_BACKOFF_H */
```

## include/eop_flush.h
```c
/**
 * @file eop_flush.h
 * @brief Counts the buffered samples delivered after a reconnection (US-402 AC2, AC6).
 * @details When the broker connection comes back, every sample already taken by the sensor is
 *          "buffered": the newest of them marks the end of the flush. The MQTT thread reports each
 *          acknowledged sample; once the one that ends the flush is delivered it publishes
 *          RECONNECTED with the count. Samples are delivered in message_id order, so the flush
 *          also ends correctly when the buffer overflowed and the oldest samples are gone.
 */

#ifndef EOP_FLUSH_H
#define EOP_FLUSH_H

#include <stdbool.h>
#include <stdint.h>

/** Flush in progress after a reconnection. */
struct eop_flush {
	bool active;        /**< A flush is waiting for its last sample. */
	uint32_t last_id;   /**< message_id of the newest buffered sample. */
	uint32_t delivered; /**< Buffered samples acknowledged so far. */
};

/**
 * @brief Starts counting after a reconnection.
 * @param flush Flush state.
 * @param backlog Whether any sample is waiting (pending or queued).
 * @param last_id message_id of the newest sample taken by the sensor.
 * @return true if there is nothing to flush: RECONNECTED can be sent now, with 0.
 */
bool eop_flush_start(struct eop_flush *flush, bool backlog, uint32_t last_id);

/**
 * @brief Reports a sample acknowledged by the broker.
 * @param flush Flush state.
 * @param message_id Its message_id.
 * @return true if it ended the flush: RECONNECTED is due, with flush->delivered.
 */
bool eop_flush_delivered(struct eop_flush *flush, uint32_t message_id);

#endif /* EOP_FLUSH_H */
```

## include/eop_led.h
```c
/**
 * @file eop_led.h
 * @brief Status LED: a blink pattern per device state (US-403 AC5).
 * @details The LED is the devicetree alias `led0`: the emulated GPIO of native_sim, or the LED the
 *          board overlay names on the ESP32. A k_timer advances the pattern every
 *          EOP_LED_TICK_MS; the supervisor chooses the pattern once per check.
 *
 *          | Pattern       | Blink                         | Meaning                            |
 *          |---------------|-------------------------------|------------------------------------|
 *          | OK            | 100 ms on every 2 s           | connected, every thread alive      |
 *          | OFFLINE       | 500 ms on, 500 ms off (1 Hz)  | no broker connection: buffering    |
 *          | THREAD_ERROR  | 100 ms on, 100 ms off (5 Hz)  | a thread was restarted lately      |
 */

#ifndef EOP_LED_H
#define EOP_LED_H

#include <stdbool.h>
#include <stdint.h>

#include <zephyr/kernel.h>
#include <zephyr/sys/atomic.h>

/** Length of one pattern step. */
#define EOP_LED_TICK_MS 100

/** LED patterns, by priority: a thread error hides being offline. */
enum eop_led_pattern {
	EOP_LED_OK,
	EOP_LED_OFFLINE,
	EOP_LED_THREAD_ERROR,
};

/** LED state. */
struct eop_led {
	struct k_timer timer; /**< Advances the pattern every EOP_LED_TICK_MS. */
	atomic_t pattern;     /**< Current eop_led_pattern. */
	atomic_t tick;        /**< Steps since the pattern started. */
};

/**
 * @brief Whether the LED is lit at step @p tick of @p pattern.
 * @param pattern Pattern.
 * @param tick Steps of EOP_LED_TICK_MS since the pattern started.
 * @return true when lit.
 */
bool eop_led_level(enum eop_led_pattern pattern, uint32_t tick);

/**
 * @brief Pattern for a device state.
 * @param connected Whether the broker connection is up.
 * @param thread_error Whether a thread was restarted lately.
 * @return The pattern to show.
 */
enum eop_led_pattern eop_led_pattern_for(bool connected, bool thread_error);

/**
 * @brief Name of a pattern, as the shell prints it.
 * @param pattern Pattern.
 * @return "ok", "offline" or "thread error".
 */
const char *eop_led_pattern_name(enum eop_led_pattern pattern);

/**
 * @brief Configures the LED GPIO, if the board has one, and starts the pattern timer.
 * @param led LED state.
 * @return 0, or a negative errno if the GPIO exists but could not be configured.
 */
int eop_led_start(struct eop_led *led);

/**
 * @brief Shows @p pattern from its first step, unless it is already showing.
 * @param led LED state.
 * @param pattern Pattern.
 */
void eop_led_show(struct eop_led *led, enum eop_led_pattern pattern);

/**
 * @brief Pattern being shown.
 * @param led LED state.
 * @return The pattern.
 */
enum eop_led_pattern eop_led_current(struct eop_led *led);

#endif /* EOP_LED_H */
```

## include/eop_link.h
```c
/**
 * @file eop_link.h
 * @brief State of the device's network link, as the MQTT thread sees it (US-402).
 * @details On native_sim the host network never goes away, so the link is a switch the shell
 *          command `eop net down|up` flips (ADR-014): while it is down the MQTT thread closes its
 *          connection and does not reconnect, and the sensor keeps filling the buffer. When the
 *          link comes back the MQTT thread is woken at once instead of finishing its backoff
 *          sleep, as a real "network connected" event would.
 */

#ifndef EOP_LINK_H
#define EOP_LINK_H

#include <stdbool.h>

#include <zephyr/kernel.h>
#include <zephyr/sys/atomic.h>

/** Link state. */
struct eop_link {
	atomic_t up;          /**< 1 while the link is up. */
	struct k_sem came_up; /**< Given on every down → up change. */
};

/**
 * @brief Prepares a link.
 * @param link Link to initialise.
 * @param up Initial state.
 */
void eop_link_init(struct eop_link *link, bool up);

/**
 * @brief Changes the link state.
 * @param link Link.
 * @param up New state.
 * @return true if the state changed.
 */
bool eop_link_set(struct eop_link *link, bool up);

/**
 * @brief Whether the link is up.
 * @param link Link.
 * @return true while up.
 */
bool eop_link_is_up(struct eop_link *link);

/**
 * @brief Waits for @p timeout, returning early if the link comes up meanwhile.
 * @param link Link.
 * @param timeout Longest wait.
 * @return true if the link came up during the wait.
 */
bool eop_link_wait_up(struct eop_link *link, k_timeout_t timeout);

/**
 * @brief Forgets earlier down → up changes, so the next wait is a full one.
 * @param link Link.
 */
void eop_link_clear(struct eop_link *link);

#endif /* EOP_LINK_H */
```

## include/eop_platform.h
```c
/**
 * @file eop_platform.h
 * @brief What differs between the ESP32 and native_sim builds (ADR-014).
 * @details Two things depend on the board: where the wall clock comes from (SNTP on the ESP32,
 *          the host on native_sim) and whether the configuration can be overridden at start
 *          (native_sim command-line options, so several simulated devices share one image).
 */

#ifndef EOP_PLATFORM_H
#define EOP_PLATFORM_H

#include <stdint.h>

#include "eop_telemetry.h"

/**
 * @brief Fills @p config from Kconfig, applies the board's overrides and draws the boot id.
 * @param config Configuration to fill.
 * @return 0, or -EINVAL if the resulting node id, bunker name or broker port is invalid.
 */
int eop_platform_config(struct eop_device_config *config);

/**
 * @brief Sets the wall clock (SYS_CLOCK_REALTIME) used for telemetry timestamps.
 * @return 0, or a negative errno if the clock could not be set (timestamps would be wrong).
 */
int eop_platform_set_clock(void);

/**
 * @brief Current wall clock in milliseconds since the Unix epoch.
 * @return Milliseconds, or -1 if the clock is unavailable.
 */
int64_t eop_platform_now_ms(void);

#endif /* EOP_PLATFORM_H */
```

## include/eop_queue.h
```c
/**
 * @file eop_queue.h
 * @brief Telemetry queue between the sensor and the MQTT thread (ADR-014).
 * @details A k_msgq of eop_telemetry. When it is full the oldest sample is discarded so the
 *          newest data is kept, and the discard is counted (US-402 AC3, AC8). Only the sensor
 *          thread puts; only the MQTT thread gets.
 */

#ifndef EOP_QUEUE_H
#define EOP_QUEUE_H

#include <stdbool.h>
#include <stdint.h>

#include <zephyr/kernel.h>
#include <zephyr/sys/atomic.h>

#include "eop_telemetry.h"

/** Queue state. */
struct eop_queue {
	struct k_msgq msgq; /**< Samples in FIFO order. */
	atomic_t dropped;   /**< Samples discarded because the queue was full, since boot. */
};

/**
 * @brief Prepares a queue over caller-provided storage.
 * @param queue Queue to initialise.
 * @param buffer Storage for @p max_samples samples, aligned to 4 bytes.
 * @param max_samples Capacity.
 */
void eop_queue_init(struct eop_queue *queue, char *buffer, uint32_t max_samples);

/**
 * @brief Adds a sample, discarding the oldest one if the queue is full.
 * @param queue Queue.
 * @param sample Sample to add.
 * @return true if an older sample was discarded to make room.
 */
bool eop_queue_put(struct eop_queue *queue, const struct eop_telemetry *sample);

/**
 * @brief Takes the oldest sample.
 * @param queue Queue.
 * @param sample Where the sample is written.
 * @param timeout How long to wait for one.
 * @return 0, or -EAGAIN when none arrived in time.
 */
int eop_queue_get(struct eop_queue *queue, struct eop_telemetry *sample, k_timeout_t timeout);

/**
 * @brief Samples waiting in the queue.
 * @param queue Queue.
 * @return Number of samples.
 */
uint32_t eop_queue_count(struct eop_queue *queue);

/**
 * @brief Samples discarded since boot because the queue was full.
 * @param queue Queue.
 * @return Number of samples.
 */
uint32_t eop_queue_dropped(struct eop_queue *queue);

#endif /* EOP_QUEUE_H */
```

## include/eop_status.h
```c
/**
 * @file eop_status.h
 * @brief Device status shared by the threads and shown by the shell (US-401 AC8, US-402 AC3).
 * @details The MQTT thread writes the connection state and publication counters; the shell
 *          command `eop status` (src/shell.c) reads them together with the queue counters, the
 *          link state, the thread restarts and the LED pattern.
 */

#ifndef EOP_STATUS_H
#define EOP_STATUS_H

#include <stdint.h>

#include <zephyr/kernel.h>

#include "eop_queue.h"

/** Broker connection state. */
enum eop_conn_state {
	EOP_CONN_DISCONNECTED, /**< No connection; waiting for the next attempt. */
	EOP_CONN_CONNECTING,   /**< TCP connect or CONNACK pending. */
	EOP_CONN_CONNECTED,    /**< CONNACK accepted. */
};

/** Status of the device since boot. */
struct eop_status_board {
	struct k_mutex lock;            /**< Guards every field below. */
	enum eop_conn_state conn_state; /**< Current broker connection state. */
	int64_t last_published_ms; /**< Wall clock of the last acknowledged sample, 0 if none. */
	uint32_t messages_sent;    /**< Samples acknowledged by the broker since boot. */
	uint32_t connect_failures; /**< Failed connection attempts since boot. */
	int64_t first_puback_uptime_ms; /**< Uptime of the first PUBACK; -1 before (AC6). */
	uint32_t reconnections;         /**< Connections restored since boot. */
	uint32_t last_delivered;        /**< Buffered samples delivered after the last one. */
	struct eop_queue *queue;        /**< Queue whose counters the status shows. */
};

/**
 * @brief Prepares the status board.
 * @param board Board to initialise.
 * @param queue Telemetry queue, for its buffered and dropped counters.
 */
void eop_status_init(struct eop_status_board *board, struct eop_queue *queue);

/**
 * @brief Records a change of connection state.
 * @param board Status board.
 * @param state New state.
 */
void eop_status_set_conn(struct eop_status_board *board, enum eop_conn_state state);

/**
 * @brief Records a failed connection attempt.
 * @param board Status board.
 */
void eop_status_connect_failed(struct eop_status_board *board);

/**
 * @brief Records a sample acknowledged by the broker.
 * @param board Status board.
 * @param sampled_at_ms Wall clock of the sample.
 * @return true if it was the first acknowledgement since boot.
 */
bool eop_status_published(struct eop_status_board *board, int64_t sampled_at_ms);

/**
 * @brief Records a finished flush after a reconnection (US-402 AC6).
 * @param board Status board.
 * @param delivered Buffered samples delivered.
 */
void eop_status_reconnected(struct eop_status_board *board, uint32_t delivered);

/** Consistent copy of the status board, for printing. */
struct eop_status_snapshot {
	enum eop_conn_state conn_state;
	int64_t last_published_ms;
	uint32_t messages_sent;
	uint32_t connect_failures;
	uint32_t reconnections;
	uint32_t last_delivered;
	uint32_t buffered;
	uint32_t dropped;
};

/**
 * @brief Takes a consistent copy of the status.
 * @param board Status board.
 * @param out Where the copy is written.
 */
void eop_status_snapshot(struct eop_status_board *board, struct eop_status_snapshot *out);

/**
 * @brief Name of a connection state, as the shell prints it.
 * @param state State.
 * @return "disconnected", "connecting" or "connected".
 */
const char *eop_conn_state_name(enum eop_conn_state state);

#endif /* EOP_STATUS_H */
```

## include/eop_telemetry.h
```c
/**
 * @file eop_telemetry.h
 * @brief Telemetry samples, device identity and their JSON encoding (US-401 AC1, AC4).
 * @details The payload is the contract of docs/edge-telemetry-protocol-v1.0.md §2.1. Temperatures
 *          are kept in tenths of a degree so that encoding needs no floating point printf.
 */

#ifndef EOP_TELEMETRY_H
#define EOP_TELEMETRY_H

#include <stdbool.h>
#include <stddef.h>
#include <stdint.h>

/** Longest node id or bunker name (protocol §2). */
#define EOP_NAME_MAX_LEN  63
/** Hex digits of a boot id (protocol §2). */
#define EOP_BOOT_ID_LEN   8
/** Length of an RFC 3339 timestamp with milliseconds, "2026-11-02T14:03:07.120Z". */
#define EOP_TIMESTAMP_LEN 24
/** Longest broker host name. */
#define EOP_HOST_MAX_LEN  253

/** Node ids with this prefix belong to the HPC engine (ADR-022). */
#define EOP_RESERVED_NODE_PREFIX "hpc-engine"

/** Device status reported with every sample (protocol §2.1). */
enum eop_status {
	EOP_STATUS_OK,
	EOP_STATUS_WARN,
	EOP_STATUS_ALERT,
};

/** One sample, as the sensor thread queues it. */
struct eop_telemetry {
	uint32_t message_id;    /**< 1, 2, 3 … within a boot. */
	int64_t sampled_at_ms;  /**< Wall clock at sampling, milliseconds since the Unix epoch. */
	int16_t temperature_dc; /**< Temperature in tenths of a degree C. */
	enum eop_status status; /**< Status derived from the temperature. */
};

/** What identifies the device and where it publishes; fixed after boot. */
struct eop_device_config {
	char node_id[EOP_NAME_MAX_LEN + 1];     /**< MQTT client id and topic segment. */
	char bunker_name[EOP_NAME_MAX_LEN + 1]; /**< Readable name. */
	char boot_id[EOP_BOOT_ID_LEN + 1];      /**< Random per boot, lowercase hex. */
	char broker_host[EOP_HOST_MAX_LEN + 1]; /**< Broker host name or address. */
	uint16_t broker_port;                   /**< Broker TCP port. */
};

/**
 * @brief Name of a status as it travels in the payload.
 * @param status Status to name.
 * @return "OK", "WARN" or "ALERT"; "OK" for an unknown value.
 */
const char *eop_status_name(enum eop_status status);

/**
 * @brief Status for a temperature, using the configured thresholds.
 * @param temperature_dc Temperature in tenths of a degree C.
 * @param warn_dc Temperature from which the status is WARN.
 * @param alert_dc Temperature from which the status is ALERT.
 * @return ALERT at or above @p alert_dc, WARN at or above @p warn_dc, OK below.
 */
enum eop_status eop_status_for(int16_t temperature_dc, int16_t warn_dc, int16_t alert_dc);

/**
 * @brief Checks a node id: [a-z0-9-]{1,63}, not starting with "hpc-engine".
 * @param node_id NUL-terminated string.
 * @return true if valid.
 */
bool eop_node_id_valid(const char *node_id);

/**
 * @brief Checks a bunker name: [A-Za-z0-9_.-]{1,63} (no spaces, it travels in key=value lines).
 * @param bunker_name NUL-terminated string.
 * @return true if valid.
 */
bool eop_bunker_name_valid(const char *bunker_name);

/**
 * @brief Writes @p epoch_ms as RFC 3339 UTC with milliseconds ("2026-11-02T14:03:07.120Z").
 * @param epoch_ms Milliseconds since the Unix epoch; must not be negative.
 * @param buf Output buffer.
 * @param len Size of @p buf; at least EOP_TIMESTAMP_LEN + 1.
 * @return Characters written (EOP_TIMESTAMP_LEN), -EINVAL for a negative time or -ENOSPC.
 */
int eop_format_timestamp(int64_t epoch_ms, char *buf, size_t len);

/**
 * @brief Encodes a sample as the telemetry JSON of the protocol (§2.1).
 * @param sample Sample to encode.
 * @param config Identity of the device.
 * @param buf Output buffer.
 * @param len Size of @p buf.
 * @return Length of the payload without the terminating NUL, or a negative errno
 *         (-ENOSPC when it does not fit, -EINVAL for a sample before the epoch).
 * @pre The identity in @p config is valid.
 */
int eop_telemetry_encode(const struct eop_telemetry *sample, const struct eop_device_config *config,
			 char *buf, size_t len);

#endif /* EOP_TELEMETRY_H */
```

## include/eop_threads.h
```c
/**
 * @file eop_threads.h
 * @brief Entry points of the application threads and their supervision (ADR-014, US-403).
 * @details main() creates the threads and hands each one its context through the first thread
 *          argument; there is no global state shared between them. The supervisor restarts a
 *          sensor or MQTT thread that stops checking in (eop_watchdog.h).
 */

#ifndef EOP_THREADS_H
#define EOP_THREADS_H

#include <zephyr/kernel.h>

#include "eop_led.h"
#include "eop_link.h"
#include "eop_queue.h"
#include "eop_status.h"
#include "eop_telemetry.h"
#include "eop_watchdog.h"

/** How to (re)create a supervised thread. */
struct eop_thread_slot {
	struct k_thread *thread; /**< Thread object. */
	k_thread_stack_t *stack; /**< Its stack. */
	size_t stack_size;       /**< Usable stack size. */
	k_thread_entry_t entry;  /**< Entry point. */
	int priority;            /**< Priority. */
	const char *name;        /**< Thread name. */
};

/** What a thread needs; one instance, owned by main(). */
struct eop_context {
	const struct eop_device_config *config; /**< Identity and broker. */
	struct eop_queue *queue;                /**< Samples from sensor to MQTT. */
	struct eop_status_board *status;        /**< Shared status. */
	struct eop_link *link;                  /**< Network link (simulated on native_sim). */
	struct eop_watchdog *wdt;               /**< Check-ins and restart counters. */
	struct eop_led *led;                    /**< Status LED. */
	const struct eop_thread_slot *slots;    /**< Supervised threads, by eop_thread_id. */
};

/**
 * @brief Sensor thread: one sample every CONFIG_EOP_SAMPLE_PERIOD_MS into the queue (US-401 AC1).
 * @param ctx struct eop_context *.
 * @param unused2 Unused.
 * @param unused3 Unused.
 */
void eop_sensor_thread(void *ctx, void *unused2, void *unused3);

/**
 * @brief MQTT thread: owns the broker connection and publishes the queued samples with QoS 1,
 *        reconnecting with exponential backoff (US-401 AC2, AC5). After a reconnection it
 *        flushes the buffer and publishes RECONNECTED (US-402 AC2, AC6); every
 *        CONFIG_EOP_HEALTH_PERIOD_MS it publishes a health report (US-402 AC8).
 * @param ctx struct eop_context *.
 * @param unused2 Unused.
 * @param unused3 Unused.
 */
void eop_mqtt_thread(void *ctx, void *unused2, void *unused3);

/**
 * @brief Supervisor thread: restarts a thread that misses its check-ins and drives the LED
 *        (US-403 AC1-AC3, AC5).
 * @param ctx struct eop_context *.
 * @param unused2 Unused.
 * @param unused3 Unused.
 */
void eop_supervisor_thread(void *ctx, void *unused2, void *unused3);

/**
 * @brief Creates thread @p id from its slot, with @p ctx as its argument.
 * @param ctx Context.
 * @param id Thread.
 */
void eop_thread_start(struct eop_context *ctx, enum eop_thread_id id);

/**
 * @brief Watchdog check-in of thread @p id; call it at least every CONFIG_EOP_WDT_TIMEOUT_MS.
 * @param ctx Context.
 * @param id Calling thread.
 */
void eop_thread_alive(struct eop_context *ctx, enum eop_thread_id id);

/**
 * @brief Check-in at the top of a thread loop; with CONFIG_EOP_FAULT_INJECT, also where an
 *        injected hang takes effect (US-403 AC6).
 * @param ctx Context.
 * @param id Calling thread.
 */
void eop_fault_point(struct eop_context *ctx, enum eop_thread_id id);

/**
 * @brief Makes the `eop` shell commands use @p ctx.
 * @param ctx Context; must outlive the shell.
 */
void eop_shell_attach(struct eop_context *ctx);

#endif /* EOP_THREADS_H */
```

## include/eop_tls.h
```c
/**
 * @file eop_tls.h
 * @brief TLS to the broker's device listener (ADR-013), built with tls.conf.
 * @details The device authenticates the broker: its certificate must chain to the CA built into
 *          the firmware (-DEOP_MQTT_CA_CERT) and name the broker host, or
 *          CONFIG_EOP_MQTT_TLS_HOSTNAME when set. The device has no certificate of its own.
 */

#ifndef EOP_TLS_H
#define EOP_TLS_H

#include <stddef.h>

#include <zephyr/net/tls_credentials.h>

/** Security tag of the broker's CA in the TLS credential store. */
#define EOP_TLS_CA_TAG 1

/**
 * @brief Adds the broker's CA to the TLS credential store.
 * @return 0 on success (also when it was already added), a negative errno otherwise.
 * @post Sockets configured with EOP_TLS_CA_TAG verify the broker against that CA.
 */
int eop_tls_init(void);

#endif /* EOP_TLS_H */
```

## include/eop_watchdog.h
```c
/**
 * @file eop_watchdog.h
 * @brief Software watchdog of the application threads (US-403 AC1, AC2, ADR-014).
 * @details Each supervised thread checks in at least once per loop. The supervisor thread asks
 *          which threads are overdue (no check-in for longer than the timeout) and restarts only
 *          those, counting each restart. Times are uptime milliseconds kept in 32 bits: the
 *          comparisons are differences, so they stay right across the 49-day wrap.
 */

#ifndef EOP_WATCHDOG_H
#define EOP_WATCHDOG_H

#include <stdbool.h>
#include <stdint.h>

#include <zephyr/sys/atomic.h>

/** Supervised threads. */
enum eop_thread_id {
	EOP_THREAD_SENSOR, /**< Sensor thread. */
	EOP_THREAD_MQTT,   /**< MQTT thread. */
	EOP_THREAD_COUNT,  /**< Number of supervised threads. */
};

/** Watchdog state of one thread. */
struct eop_wdt_entry {
	atomic_t last_checkin_ms; /**< Uptime of the last check-in, low 32 bits. */
	atomic_t restarts;        /**< Restarts since boot. */
	atomic_t hang_requested; /**< Fault injection: hang at the next fault point (US-403 AC6). */
};

/** Watchdog of every supervised thread. */
struct eop_watchdog {
	struct eop_wdt_entry entry[EOP_THREAD_COUNT]; /**< Indexed by eop_thread_id. */
	uint32_t timeout_ms;                          /**< Longest time between check-ins. */
	atomic_t last_restart_ms;                     /**< Uptime of the last restart. */
	atomic_t any_restart;                         /**< 1 once a thread was restarted. */
};

/**
 * @brief Prepares the watchdog; every thread counts as just checked in.
 * @param wdt Watchdog.
 * @param timeout_ms Longest time between check-ins.
 * @param now_ms Current uptime.
 */
void eop_wdt_init(struct eop_watchdog *wdt, uint32_t timeout_ms, int64_t now_ms);

/**
 * @brief Records that @p id is alive.
 * @param wdt Watchdog.
 * @param id Thread.
 * @param now_ms Current uptime.
 */
void eop_wdt_checkin(struct eop_watchdog *wdt, enum eop_thread_id id, int64_t now_ms);

/**
 * @brief Threads whose last check-in is older than the timeout.
 * @param wdt Watchdog.
 * @param now_ms Current uptime.
 * @return Bit (1 << id) set for every overdue thread.
 */
uint32_t eop_wdt_overdue(struct eop_watchdog *wdt, int64_t now_ms);

/**
 * @brief Records a restart of @p id: counts it and gives the new thread a full timeout.
 * @param wdt Watchdog.
 * @param id Thread.
 * @param now_ms Current uptime.
 */
void eop_wdt_restarted(struct eop_watchdog *wdt, enum eop_thread_id id, int64_t now_ms);

/**
 * @brief Restarts of @p id since boot.
 * @param wdt Watchdog.
 * @param id Thread.
 * @return Count.
 */
uint32_t eop_wdt_restarts(struct eop_watchdog *wdt, enum eop_thread_id id);

/**
 * @brief Whether a thread was restarted less than @p window_ms ago.
 * @param wdt Watchdog.
 * @param now_ms Current uptime.
 * @param window_ms Window.
 * @return true inside the window.
 */
bool eop_wdt_recent_restart(struct eop_watchdog *wdt, int64_t now_ms, uint32_t window_ms);

/**
 * @brief Name of a thread, as logs and the shell print it.
 * @param id Thread.
 * @return "sensor" or "mqtt"; "unknown" for an invalid id.
 */
const char *eop_thread_name(enum eop_thread_id id);

/**
 * @brief Fault injection: makes @p id hang at its next fault point (US-403 AC6).
 * @param wdt Watchdog.
 * @param id Thread.
 */
void eop_wdt_request_hang(struct eop_watchdog *wdt, enum eop_thread_id id);

/**
 * @brief Takes a pending hang request of @p id.
 * @param wdt Watchdog.
 * @param id Thread.
 * @return true once per request.
 */
bool eop_wdt_take_hang(struct eop_watchdog *wdt, enum eop_thread_id id);

#endif /* EOP_WATCHDOG_H */
```

## src/backoff.c
```c
#include "eop_backoff.h"

#define BACKOFF_FACTOR 2U

void eop_backoff_init(struct eop_backoff *backoff, uint32_t initial_s, uint32_t max_s)
{
	backoff->initial_s = initial_s == 0U ? 1U : initial_s;
	backoff->max_s = max_s < backoff->initial_s ? backoff->initial_s : max_s;
	backoff->next_s = backoff->initial_s;
}

uint32_t eop_backoff_next(struct eop_backoff *backoff)
{
	uint32_t delay = backoff->next_s;

	/* Compare before multiplying so the doubling can never overflow. */
	if (backoff->next_s > backoff->max_s / BACKOFF_FACTOR) {
		backoff->next_s = backoff->max_s;
	} else {
		backoff->next_s *= BACKOFF_FACTOR;
	}
	return delay;
}

void eop_backoff_reset(struct eop_backoff *backoff)
{
	backoff->next_s = backoff->initial_s;
}
```
